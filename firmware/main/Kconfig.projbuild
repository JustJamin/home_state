## firmware/main/Kconfig.projbuild
```kconfig
menu "home_state node"

    choice HS_APP
        prompt "Node app"
        default HS_APP_SINGLE_BLINK
        help
            Set by firmware/apps/<app>/app.defaults; must match the project name
            (-DHS_APP=<app>). Chooses the LED pattern and the app's settings.
        config HS_APP_SINGLE_BLINK
            bool "single-blink"
        config HS_APP_DOUBLE_BLINK
            bool "double-blink"
        config HS_APP_HS_ADVERTISER
            bool "hs_advertiser (legacy bridge)"
    endchoice

    config HS_APP_NAME
        string
        default "single-blink" if HS_APP_SINGLE_BLINK
        default "double-blink" if HS_APP_DOUBLE_BLINK
        default "hs_advertiser" if HS_APP_HS_ADVERTISER


    config HS_BOARD_ID
        int "Board ID"
        range 0 255
        default 1
        help
            Board ID stored in NVS the first time a board boots with empty NVS.
            Goes into the payload and the device name (hs-<id>). Change it later
            with the board.set_id JSON-RPC method.

    config HS_TEST_NEVER_VALID
        bool "TEST: never mark a new OTA image valid"
        default n
        help
            Rollback test build. After an OTA the image stays pending, the 60 s
            verify timer fires and the bootloader goes back to the previous image.

    config HS_TEST_PANIC_ON_BOOT
        bool "TEST: abort() at boot"
        default n
        help
            Rollback test build. The image crashes on boot, so the bootloader
            rolls back to the previous image. Never flash this over USB:
            with no previous image it would boot-loop.

endmenu
```
